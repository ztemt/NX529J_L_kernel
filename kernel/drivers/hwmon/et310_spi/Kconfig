## kernel/drivers/hwmon/et310_spi/Kconfig
```kconfig
#config ZTEMT_SENSORS_FP_ET310
#	tristate "ztemt sensors fp et310"
#	default n
#	help
#	  This is the main file for fingerprint driver for et310.
#	  Say Y here if you have a et310 fingerprint connected
#	  to your system.

menuconfig ZTEMT_SENSORS_FP_ET310
	tristate "ztemt sensors fp et310"
	default n
	help
	  This is the main file for fingerprint driver for et310.
	  Say Y here if you have a et310 fingerprint connected
	  to your system.

if ZTEMT_SENSORS_FP_ET310

config ZTEMT_SENSORS_FP_ET310_CONTROL_BY_AP
	bool "Enable Spi by AP"
	default n
	help
	  Say Y here to enable spi by AP.
	  Say N here to enable spi by TZ.
endif
```

## kernel/drivers/hwmon/gf318m_spi/Kconfig
```kconfig
config ZTEMT_SENSORS_FP_GF318M
	tristate "ztemt sensors fp gf318m"
	depends on ZTEMT_SENSORS_FP
	default n
	help
	  This is the main file for fingerprint driver for gf318m.
	  Say Y here if you have a gf318m fingerprint connected
	  to your system.

config ZTEMT_N940_FP_COMPATIBLE
	tristate "ztemt sensors fp gf318m N940 compatible"
	default n

config ZTEMT_FP_COMPATIBLE
	tristate "ztemt sensors fp gf318m compatible"
	default n
```

## kernel/drivers/input/touchscreen/gt1x/Kconfig
```kconfig
#
# Goodix GT1X Touchscreen driver
#

menuconfig ZTEMT_TOUCHSCREEN_GT1X
	bool "ZTEMT_TOUCHSCREEN_GT1X"
	help
	  Say Y here, and a list of supported touchscreens will be displayed.
	  This option doesn't affect the kernel.

	  If unsure, say Y.

if ZTEMT_TOUCHSCREEN_GT1X

config ZTEMT_GT1X_TOUCHSCREEN_DRIVER
	tristate "Goodix GT1X touchpanel driver"
	depends on ZTEMT_TOUCHSCREEN_GT1X
	default n
	help
	  This is the main file for touchpanel driver for Goodix GT1X
	  touchscreens.

	  Say Y here if you have a Goodix GT1X touchscreen connected
	  to your system.

	  If unsure, say N.

endif
```
