/*
 * Copyright (c) 2015, The Linux Foundation. All rights reserved.
 *
 * This program is free software; you can redistribute it and/or modify
 * it under the terms of the GNU General Public License version 2 and
 * only version 2 as published by the Free Software Foundation.
 *
 * This program is distributed in the hope that it will be useful,
 * but WITHOUT ANY WARRANTY; without even the implied warranty of
 * MERCHANTABILITY or FITNESS FOR A PARTICULAR PURPOSE.  See the
 * GNU General Public License for more details.
 */
    &i2c_2 { /* BLSP1 QUP2 */
	   ktd2037@30 {
		compatible = "ktd,ktd2037";
		reg = <0x30>;
		ktd2037,name = "nubia_led";
		ktd2037,max-brightness = <255>;
		ktd2037,main_channel = <2>;
	    ktd2037,second_channel = <0>;
	    ktd2037,third_channel = <1>;
	   };
    };
