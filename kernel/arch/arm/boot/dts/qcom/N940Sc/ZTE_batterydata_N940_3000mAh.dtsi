
qcom,zte_n940_3000mah {
	/* #2162072_ZTE_N940_3000mAh_averaged_MasterSlave_Sept21st2015*/
	qcom,max-voltage-uv = <4350000>;
	qcom,nom-batt-capacity-mah = <3000>;
	qcom,batt-id-kohm = <470>;
	qcom,battery-beta = <3800>;
	qcom,battery-type = "zte_n940_3000mah";
	qcom,chg-rslow-comp-c1 = <3475546>;
	qcom,chg-rslow-comp-c2 = <5255570>;
	qcom,chg-rs-to-rslow = <1032152>;
	qcom,chg-rslow-comp-thr = <0xAB>;
	qcom,checksum = <0x442D>;
	qcom,gui-version = "PMI8950GUI - 2.0.0.14";
	qcom,fg-profile-data = [
		 02 88 EE 7D 
		 B0 81 33 7C 
		 56 83 6C 45 
		 48 80 74 86 
		 15 82 3E 9A 
		 38 BD 02 CA 
		 65 0E 06 88 
		 D9 7D A1 81 
		 2D 7C 65 83 
		 04 6C 44 88 
		 7F 8F 60 82 
		 83 99 E6 BC 
		 DB C9 58 0D 
		 17 0C 95 5B 
		 CE 6E 71 FD 
		 12 44 AD 46 
		 E2 42 00 00 
		 A9 46 16 28 
		 FE 1A 00 00 
		 00 00 00 00 
		 00 00 00 00 
		 40 71 31 6B 
		 B8 6B FD 89 
		 37 7D 4A 72 
		 9C 65 F7 7B 
		 70 77 16 70 
		 89 66 19 A8 
		 24 39 60 4D 
		 5E A0 71 0C 
		 28 00 FF 36 
		 F0 11 30 03 
		 00 00 00 0C 
	];
};
