/* Copyright (c) 2013, The Linux Foundation. All rights reserved.
 *
 * This program is free software; you can redistribute it and/or modify
 * it under the terms of the GNU General Public License version 2 and
 * only version 2 as published by the Free Software Foundation.
 *
 * This program is distributed in the hope that it will be useful,
 * but WITHOUT ANY WARRANTY; without even the implied warranty of
 * MERCHANTABILITY or FITNESS FOR A PARTICULAR PURPOSE.  See the
 * GNU General Public License for more details.
 */

/*---------------------------------------------------------------------------
 * This file is autogenerated file using gcdb parser. Please do not edit it.
 * Update input XML file to add a new entry or update variable in this file
 * VERSION = "1.0"
 *---------------------------------------------------------------------------*/
&mdss_mdp {
	dsi_sharp_nt35595_1080_5p0_cmd: qcom,mdss_dsi_sharp_nt35595_1080p_5p0_command {
		qcom,mdss-dsi-panel-name = "sharp nt35595 1080p 5p0 command mode dsi panel";
		qcom,mdss-dsi-panel-controller = <&mdss_dsi0>;
		qcom,mdss-dsi-panel-type = "dsi_cmd_mode";
		qcom,mdss-dsi-panel-destination = "display_1";
		qcom,mdss-dsi-panel-framerate = <60>;
		qcom,mdss-dsi-virtual-channel-id = <0>;
		qcom,mdss-dsi-stream = <0>;
		qcom,mdss-dsi-panel-width = <1080>;
		qcom,mdss-dsi-panel-height = <1920>;
		qcom,mdss-dsi-h-front-porch = <130>;
		qcom,mdss-dsi-h-back-porch = <60>;
		qcom,mdss-dsi-h-pulse-width = <12>;
		qcom,mdss-dsi-h-sync-skew = <0>;
		qcom,mdss-dsi-v-back-porch = <18>;
		qcom,mdss-dsi-v-front-porch = <8>;
		qcom,mdss-dsi-v-pulse-width = <2>;
		qcom,mdss-dsi-h-left-border = <0>;
		qcom,mdss-dsi-h-right-border = <0>;
		qcom,mdss-dsi-v-top-border = <0>;
		qcom,mdss-dsi-v-bottom-border = <0>;
		qcom,mdss-dsi-bpp = <24>;
		qcom,mdss-dsi-color-order = <0>;
		qcom,mdss-dsi-underflow-color = <0xff>;
		qcom,mdss-dsi-border-color = <0>;
		qcom,mdss-dsi-lane-map = "lane_map_0123";
		qcom,mdss-dsi-on-command = [
			15 01 00 00 00 00 02 FF 10
			15 01 00 00 00 00 02 BB 10  //command
			15 01 00 00 00 00 02 B0 03

			15 01 00 00 00 00 02 FF 10
			15 01 00 00 00 00 02 35 00
			15 01 00 00 64 00 02 11 00

			// set te output after 11 command
			15 01 00 00 00 00 02 FF 24
			15 01 00 00 00 00 02 C4 60
			15 01 00 00 00 00 02 C9 00
			15 01 00 00 00 00 02 FB 01
			15 01 00 00 00 00 02 FF 10

			//gamma start
			15 01 00 00 00 00 02 FF	20
			15 01 00 00 00 00 02 75	01
			15 01 00 00 00 00 02 76	68
			15 01 00 00 00 00 02 77	01
			15 01 00 00 00 00 02 78	6C
			15 01 00 00 00 00 02 79	01
			15 01 00 00 00 00 02 7A	73
			15 01 00 00 00 00 02 7B	01
			15 01 00 00 00 00 02 7C	7A
			15 01 00 00 00 00 02 7D	01
			15 01 00 00 00 00 02 7E	81
			15 01 00 00 00 00 02 7F	01
			15 01 00 00 00 00 02 80	88
			15 01 00 00 00 00 02 81	01
			15 01 00 00 00 00 02 82	8F
			15 01 00 00 00 00 02 83	01
			15 01 00 00 00 00 02 84	94
			15 01 00 00 00 00 02 85	01
			15 01 00 00 00 00 02 86	9B
			15 01 00 00 00 00 02 87	01
			15 01 00 00 00 00 02 88	B0
			15 01 00 00 00 00 02 89	01
			15 01 00 00 00 00 02 8A	C5
			15 01 00 00 00 00 02 8B	01
			15 01 00 00 00 00 02 8C	E7
			15 01 00 00 00 00 02 8D	02
			15 01 00 00 00 00 02 8E	04
			15 01 00 00 00 00 02 8F	02
			15 01 00 00 00 00 02 90	37
			15 01 00 00 00 00 02 91	02
			15 01 00 00 00 00 02 92	61
			15 01 00 00 00 00 02 93	02
			15 01 00 00 00 00 02 94	62
			15 01 00 00 00 00 02 95	02
			15 01 00 00 00 00 02 96	8D
			15 01 00 00 00 00 02 97	02
			15 01 00 00 00 00 02 98	BF
			15 01 00 00 00 00 02 99	02
			15 01 00 00 00 00 02 9A	E0
			15 01 00 00 00 00 02 9B	03
			15 01 00 00 00 00 02 9C	0E
			15 01 00 00 00 00 02 9D	03
			15 01 00 00 00 00 02 9E	2D
			15 01 00 00 00 00 02 9F	03
			15 01 00 00 00 00 02 A0	52
			15 01 00 00 00 00 02 A2	03
			15 01 00 00 00 00 02 A3	5E
			15 01 00 00 00 00 02 A4	03
			15 01 00 00 00 00 02 A5	6A
			15 01 00 00 00 00 02 A6	03
			15 01 00 00 00 00 02 A7	77
			15 01 00 00 00 00 02 A9	03
			15 01 00 00 00 00 02 AA	85
			15 01 00 00 00 00 02 AB	03
			15 01 00 00 00 00 02 AC	94
			15 01 00 00 00 00 02 AD	03
			15 01 00 00 00 00 02 AE	A6
			15 01 00 00 00 00 02 AF	03
			15 01 00 00 00 00 02 B0	BA
			15 01 00 00 00 00 02 B1	03
			15 01 00 00 00 00 02 B2	C6
			15 01 00 00 00 00 02 B3	01
			15 01 00 00 00 00 02 B4	68
			15 01 00 00 00 00 02 B5	01
			15 01 00 00 00 00 02 B6	6C
			15 01 00 00 00 00 02 B7	01
			15 01 00 00 00 00 02 B8	73
			15 01 00 00 00 00 02 B9	01
			15 01 00 00 00 00 02 BA	7A
			15 01 00 00 00 00 02 BB	01
			15 01 00 00 00 00 02 BC	81
			15 01 00 00 00 00 02 BD	01
			15 01 00 00 00 00 02 BE	88
			15 01 00 00 00 00 02 BF	01
			15 01 00 00 00 00 02 C0	8F
			15 01 00 00 00 00 02 C1	01
			15 01 00 00 00 00 02 C2	94
			15 01 00 00 00 00 02 C3	01
			15 01 00 00 00 00 02 C4	9B
			15 01 00 00 00 00 02 C5	01
			15 01 00 00 00 00 02 C6	B0
			15 01 00 00 00 00 02 C7	01
			15 01 00 00 00 00 02 C8	C5
			15 01 00 00 00 00 02 C9	01
			15 01 00 00 00 00 02 CA	E7
			15 01 00 00 00 00 02 CB	02
			15 01 00 00 00 00 02 CC	04
			15 01 00 00 00 00 02 CD	02
			15 01 00 00 00 00 02 CE	37
			15 01 00 00 00 00 02 CF	02
			15 01 00 00 00 00 02 D0	61
			15 01 00 00 00 00 02 D1	02
			15 01 00 00 00 00 02 D2	62
			15 01 00 00 00 00 02 D3	02
			15 01 00 00 00 00 02 D4	8D
			15 01 00 00 00 00 02 D5	02
			15 01 00 00 00 00 02 D6	BF
			15 01 00 00 00 00 02 D7	02
			15 01 00 00 00 00 02 D8	E0
			15 01 00 00 00 00 02 D9	03
			15 01 00 00 00 00 02 DA	0E
			15 01 00 00 00 00 02 DB	03
			15 01 00 00 00 00 02 DC	2D
			15 01 00 00 00 00 02 DD	03
			15 01 00 00 00 00 02 DE	52
			15 01 00 00 00 00 02 DF	03
			15 01 00 00 00 00 02 E0	5E
			15 01 00 00 00 00 02 E1	03
			15 01 00 00 00 00 02 E2	6A
			15 01 00 00 00 00 02 E3	03
			15 01 00 00 00 00 02 E4	77
			15 01 00 00 00 00 02 E5	03
			15 01 00 00 00 00 02 E6	85
			15 01 00 00 00 00 02 E7	03
			15 01 00 00 00 00 02 E8	94
			15 01 00 00 00 00 02 E9	03
			15 01 00 00 00 00 02 EA	A6
			15 01 00 00 00 00 02 EB	03
			15 01 00 00 00 00 02 EC	BA
			15 01 00 00 00 00 02 ED	03
			15 01 00 00 00 00 02 EE	C6
			15 01 00 00 00 00 02 EF	00
			15 01 00 00 00 00 02 F0	5E
			15 01 00 00 00 00 02 F1	00
			15 01 00 00 00 00 02 F2	A0
			15 01 00 00 00 00 02 F3	00
			15 01 00 00 00 00 02 F4	CA
			15 01 00 00 00 00 02 F5	00
			15 01 00 00 00 00 02 F6	E4
			15 01 00 00 00 00 02 F7	00
			15 01 00 00 00 00 02 F8	FA
			15 01 00 00 00 00 02 F9	01
			15 01 00 00 00 00 02 FA	0C
			15 01 00 00 00 00 02 FF	21
			15 01 00 00 00 00 02 00	01
			15 01 00 00 00 00 02 01	1B
			15 01 00 00 00 00 02 02	01
			15 01 00 00 00 00 02 03	29
			15 01 00 00 00 00 02 04	01
			15 01 00 00 00 00 02 05	35
			15 01 00 00 00 00 02 06	01
			15 01 00 00 00 00 02 07	5F
			15 01 00 00 00 00 02 08	01
			15 01 00 00 00 00 02 09	80
			15 01 00 00 00 00 02 0A	01
			15 01 00 00 00 00 02 0B	B4
			15 01 00 00 00 00 02 0C	01
			15 01 00 00 00 00 02 0D	DD
			15 01 00 00 00 00 02 0E	02
			15 01 00 00 00 00 02 0F	1C
			15 01 00 00 00 00 02 10	02
			15 01 00 00 00 00 02 11	4F
			15 01 00 00 00 00 02 12	02
			15 01 00 00 00 00 02 13	50
			15 01 00 00 00 00 02 14	02
			15 01 00 00 00 00 02 15	7F
			15 01 00 00 00 00 02 16	02
			15 01 00 00 00 00 02 17	B2
			15 01 00 00 00 00 02 18	02
			15 01 00 00 00 00 02 19	D5
			15 01 00 00 00 00 02 1A	03
			15 01 00 00 00 00 02 1B	04
			15 01 00 00 00 00 02 1C	03
			15 01 00 00 00 00 02 1D	23
			15 01 00 00 00 00 02 1E	03
			15 01 00 00 00 00 02 1F	4B
			15 01 00 00 00 00 02 20	03
			15 01 00 00 00 00 02 21	57
			15 01 00 00 00 00 02 22	03
			15 01 00 00 00 00 02 23	64
			15 01 00 00 00 00 02 24	03
			15 01 00 00 00 00 02 25	72
			15 01 00 00 00 00 02 26	03
			15 01 00 00 00 00 02 27	82
			15 01 00 00 00 00 02 28	03
			15 01 00 00 00 00 02 29	93
			15 01 00 00 00 00 02 2A	03
			15 01 00 00 00 00 02 2B	A9
			15 01 00 00 00 00 02 2D	03
			15 01 00 00 00 00 02 2F	C2
			15 01 00 00 00 00 02 30	03
			15 01 00 00 00 00 02 31	C6
			15 01 00 00 00 00 02 32	00
			15 01 00 00 00 00 02 33	5E
			15 01 00 00 00 00 02 34	00
			15 01 00 00 00 00 02 35	A0
			15 01 00 00 00 00 02 36	00
			15 01 00 00 00 00 02 37	CA
			15 01 00 00 00 00 02 38	00
			15 01 00 00 00 00 02 39	E4
			15 01 00 00 00 00 02 3A	00
			15 01 00 00 00 00 02 3B	FA
			15 01 00 00 00 00 02 3D	01
			15 01 00 00 00 00 02 3F	0C
			15 01 00 00 00 00 02 40	01
			15 01 00 00 00 00 02 41	1B
			15 01 00 00 00 00 02 42	01
			15 01 00 00 00 00 02 43	29
			15 01 00 00 00 00 02 44	01
			15 01 00 00 00 00 02 45	35
			15 01 00 00 00 00 02 46	01
			15 01 00 00 00 00 02 47	5F
			15 01 00 00 00 00 02 48	01
			15 01 00 00 00 00 02 49	80
			15 01 00 00 00 00 02 4A	01
			15 01 00 00 00 00 02 4B	B4
			15 01 00 00 00 00 02 4C	01
			15 01 00 00 00 00 02 4D	DD
			15 01 00 00 00 00 02 4E	02
			15 01 00 00 00 00 02 4F	1C
			15 01 00 00 00 00 02 50	02
			15 01 00 00 00 00 02 51	4F
			15 01 00 00 00 00 02 52	02
			15 01 00 00 00 00 02 53	50
			15 01 00 00 00 00 02 54	02
			15 01 00 00 00 00 02 55	7F
			15 01 00 00 00 00 02 56	02
			15 01 00 00 00 00 02 58	B2
			15 01 00 00 00 00 02 59	02
			15 01 00 00 00 00 02 5A	D5
			15 01 00 00 00 00 02 5B	03
			15 01 00 00 00 00 02 5C	04
			15 01 00 00 00 00 02 5D	03
			15 01 00 00 00 00 02 5E	23
			15 01 00 00 00 00 02 5F	03
			15 01 00 00 00 00 02 60	4B
			15 01 00 00 00 00 02 61	03
			15 01 00 00 00 00 02 62	57
			15 01 00 00 00 00 02 63	03
			15 01 00 00 00 00 02 64	64
			15 01 00 00 00 00 02 65	03
			15 01 00 00 00 00 02 66	72
			15 01 00 00 00 00 02 67	03
			15 01 00 00 00 00 02 68	82
			15 01 00 00 00 00 02 69	03
			15 01 00 00 00 00 02 6A	93
			15 01 00 00 00 00 02 6B	03
			15 01 00 00 00 00 02 6C	A9
			15 01 00 00 00 00 02 6D	03
			15 01 00 00 00 00 02 6E	C2
			15 01 00 00 00 00 02 6F	03
			15 01 00 00 00 00 02 70	C6
			15 01 00 00 00 00 02 71	01
			15 01 00 00 00 00 02 72	43
			15 01 00 00 00 00 02 73	01
			15 01 00 00 00 00 02 74	48
			15 01 00 00 00 00 02 75	01
			15 01 00 00 00 00 02 76	51
			15 01 00 00 00 00 02 77	01
			15 01 00 00 00 00 02 78	5B
			15 01 00 00 00 00 02 79	01
			15 01 00 00 00 00 02 7A	63
			15 01 00 00 00 00 02 7B	01
			15 01 00 00 00 00 02 7C	6B
			15 01 00 00 00 00 02 7D	01
			15 01 00 00 00 00 02 7E	72
			15 01 00 00 00 00 02 7F	01
			15 01 00 00 00 00 02 80	7A
			15 01 00 00 00 00 02 81	01
			15 01 00 00 00 00 02 82	81
			15 01 00 00 00 00 02 83	01
			15 01 00 00 00 00 02 84	9B
			15 01 00 00 00 00 02 85	01
			15 01 00 00 00 00 02 86	B1
			15 01 00 00 00 00 02 87	01
			15 01 00 00 00 00 02 88	D8
			15 01 00 00 00 00 02 89	01
			15 01 00 00 00 00 02 8A	F8
			15 01 00 00 00 00 02 8B	02
			15 01 00 00 00 00 02 8C	2E
			15 01 00 00 00 00 02 8D	02
			15 01 00 00 00 00 02 8E	5C
			15 01 00 00 00 00 02 8F	02
			15 01 00 00 00 00 02 90	5D
			15 01 00 00 00 00 02 91	02
			15 01 00 00 00 00 02 92	88
			15 01 00 00 00 00 02 93	02
			15 01 00 00 00 00 02 94	BA
			15 01 00 00 00 00 02 95	02
			15 01 00 00 00 00 02 96	DD
			15 01 00 00 00 00 02 97	03
			15 01 00 00 00 00 02 98	0B
			15 01 00 00 00 00 02 99	03
			15 01 00 00 00 00 02 9A	29
			15 01 00 00 00 00 02 9B	03
			15 01 00 00 00 00 02 9C	4F
			15 01 00 00 00 00 02 9D	03
			15 01 00 00 00 00 02 9E	5B
			15 01 00 00 00 00 02 9F	03
			15 01 00 00 00 00 02 A0	67
			15 01 00 00 00 00 02 A2	03
			15 01 00 00 00 00 02 A3	74
			15 01 00 00 00 00 02 A4	03
			15 01 00 00 00 00 02 A5	83
			15 01 00 00 00 00 02 A6	03
			15 01 00 00 00 00 02 A7	93
			15 01 00 00 00 00 02 A9	03
			15 01 00 00 00 00 02 AA	A6
			15 01 00 00 00 00 02 AB	03
			15 01 00 00 00 00 02 AC	C4
			15 01 00 00 00 00 02 AD	03
			15 01 00 00 00 00 02 AE	C6
			15 01 00 00 00 00 02 AF	01
			15 01 00 00 00 00 02 B0	43
			15 01 00 00 00 00 02 B1	01
			15 01 00 00 00 00 02 B2	48
			15 01 00 00 00 00 02 B3	01
			15 01 00 00 00 00 02 B4	51
			15 01 00 00 00 00 02 B5	01
			15 01 00 00 00 00 02 B6	5B
			15 01 00 00 00 00 02 B7	01
			15 01 00 00 00 00 02 B8	63
			15 01 00 00 00 00 02 B9	01
			15 01 00 00 00 00 02 BA	6B
			15 01 00 00 00 00 02 BB	01
			15 01 00 00 00 00 02 BC	72
			15 01 00 00 00 00 02 BD	01
			15 01 00 00 00 00 02 BE	7A
			15 01 00 00 00 00 02 BF	01
			15 01 00 00 00 00 02 C0	81
			15 01 00 00 00 00 02 C1	01
			15 01 00 00 00 00 02 C2	9B
			15 01 00 00 00 00 02 C3	01
			15 01 00 00 00 00 02 C4	B1
			15 01 00 00 00 00 02 C5	01
			15 01 00 00 00 00 02 C6	D8
			15 01 00 00 00 00 02 C7	01
			15 01 00 00 00 00 02 C8	F8
			15 01 00 00 00 00 02 C9	02
			15 01 00 00 00 00 02 CA	2E
			15 01 00 00 00 00 02 CB	02
			15 01 00 00 00 00 02 CC	5C
			15 01 00 00 00 00 02 CD	02
			15 01 00 00 00 00 02 CE	5D
			15 01 00 00 00 00 02 CF	02
			15 01 00 00 00 00 02 D0	88
			15 01 00 00 00 00 02 D1	02
			15 01 00 00 00 00 02 D2	BA
			15 01 00 00 00 00 02 D3	02
			15 01 00 00 00 00 02 D4	DD
			15 01 00 00 00 00 02 D5	03
			15 01 00 00 00 00 02 D6	0B
			15 01 00 00 00 00 02 D7	03
			15 01 00 00 00 00 02 D8	29
			15 01 00 00 00 00 02 D9	03
			15 01 00 00 00 00 02 DA	4F
			15 01 00 00 00 00 02 DB	03
			15 01 00 00 00 00 02 DC	5B
			15 01 00 00 00 00 02 DD	03
			15 01 00 00 00 00 02 DE	67
			15 01 00 00 00 00 02 DF	03
			15 01 00 00 00 00 02 E0	74
			15 01 00 00 00 00 02 E1	03
			15 01 00 00 00 00 02 E2	83
			15 01 00 00 00 00 02 E3	03
			15 01 00 00 00 00 02 E4	93
			15 01 00 00 00 00 02 E5	03
			15 01 00 00 00 00 02 E6	A6
			15 01 00 00 00 00 02 E7	03
			15 01 00 00 00 00 02 E8	C4
			15 01 00 00 00 00 02 E9	03
			15 01 00 00 00 00 02 EA	C6
			//gamma end 

			// set pwm to 35K
			15 01 00 00 00 00 02 FF 23
			15 01 00 00 00 00 02 07 20
			15 01 00 00 00 00 02 08 04
			15 01 00 00 00 00 02 46 2C
			15 01 00 00 00 00 02 FB 01

			15 01 00 00 00 00 02 FF 10
			15 01 00 00 00 00 02 53 2c
			15 01 00 00 00 00 02 55 00
			15 01 00 00 00 00 02 51	ff

			15 01 00 00 00 00 02 FF F0
			15 01 00 00 00 00 02 92 01

			15 01 00 00 00 00 02 FF 22
                        15 01 00 00 00 00 02 14 07
                        15 01 00 00 00 00 02 15 08
                        15 01 00 00 00 00 02 1A 77
                        15 01 00 00 00 00 02 56 00
                        15 01 00 00 00 00 02 68 00
                        15 01 00 00 00 00 02 FB 01

			15 01 00 00 00 00 02 FF 10
			15 01 00 00 28 00 02 29 00];
		qcom,mdss-dsi-off-command = [
			15 01 00 00 00 00 02 FF 10
			39 01 00 00 11 00 02 28 00
			39 01 00 00 43 00 02 10 00];

		zte,mdss-dsi-ce-command-off = [
                        ];
		zte,mdss-dsi-ce-command-soft = [
			];
		zte,mdss-dsi-ce-command-std = [
                        ];
		zte,mdss-dsi-ce-command-glow = [
                        ];

		zte,mdss-dsi-cabc-command-off = [
			];
		zte,mdss-dsi-ce-command-lever1 = [
			];
		zte,mdss-dsi-ce-command-lever2 = [
			];
		zte,mdss-dsi-ce-command-lever3 = [
			];


		zte,mdss-dsi-ce-cabc-command0 = [
                        15 01 00 00 00 00 02 FF 10
                        15 01 00 00 00 00 02 55 00];
		zte,mdss-dsi-ce-cabc-command1 = [
                        15 01 00 00 00 00 02 FF 10
                        15 01 00 00 00 00 02 55 01];
		zte,mdss-dsi-ce-cabc-command2 = [
                        15 01 00 00 00 00 02 FF 10
                        15 01 00 00 00 00 02 55 02];
		zte,mdss-dsi-ce-cabc-command3 = [
                        15 01 00 00 00 00 02 FF 10
                        15 01 00 00 00 00 02 55 03];
		zte,mdss-dsi-ce-cabc-command4 = [
                        15 01 00 00 00 00 02 FF 10
                        15 01 00 00 00 00 02 55 80];
		zte,mdss-dsi-ce-cabc-command5 = [
                        15 01 00 00 00 00 02 FF 10
                        15 01 00 00 00 00 02 55 81];
                zte,mdss-dsi-ce-cabc-command6 = [
                        15 01 00 00 00 00 02 FF 10
                        15 01 00 00 00 00 02 55 82];
                zte,mdss-dsi-ce-cabc-command7 = [
                        15 01 00 00 00 00 02 FF 10
                        15 01 00 00 00 00 02 55 83];
		zte,mdss-dsi-ce-cabc-command8 = [
                        15 01 00 00 00 00 02 FF 10
                        15 01 00 00 00 00 02 55 90];
                zte,mdss-dsi-ce-cabc-command9 = [
                        15 01 00 00 00 00 02 FF 10
                        15 01 00 00 00 00 02 55 91];
                zte,mdss-dsi-ce-cabc-command10 = [
                        15 01 00 00 00 00 02 FF 10
                        15 01 00 00 00 00 02 55 92];
                zte,mdss-dsi-ce-cabc-command11 = [
                        15 01 00 00 00 00 02 FF 10
                        15 01 00 00 00 00 02 55 93];
		zte,mdss-dsi-ce-cabc-command12 = [
                        15 01 00 00 00 00 02 FF 10
                        15 01 00 00 00 00 02 55 b0];
                zte,mdss-dsi-ce-cabc-command13 = [
                        15 01 00 00 00 00 02 FF 10
                        15 01 00 00 00 00 02 55 b1];
                zte,mdss-dsi-ce-cabc-command14 = [
                        15 01 00 00 00 00 02 FF 10
                        15 01 00 00 00 00 02 55 b2];
                zte,mdss-dsi-ce-cabc-command15 = [
                        15 01 00 00 00 00 02 FF 10
                        15 01 00 00 00 00 02 55 b3];


		zte,mdss-dsi-panel-backlight-curve = [
			00 01 02 03 04 05 06 07
			08 09 0A 0B 0C 0D 0E 0F
			10 11 12 13 14 15 16 17
			18 19 1A 1B 1C 1D 1E 1F
			20 21 22 23 24 25 26 27
			28 29 2A 2B 2C 2D 2E 2F
			30 31 32 33 34 35 36 37
			38 39 3A 3B 3C 3D 3E 3F
			40 41 42 43 44 45 46 47
			48 49 4A 4B 4C 4D 4E 4F
			50 51 52 53 54 55 56 57
			58 59 5A 5B 5C 5D 5E 5F
			60 61 62 63 64 65 66 67
			68 69 6A 6B 6C 6D 6E 6F
			70 71 72 73 74 75 76 77
			78 79 7A 7B 7C 7D 7E 7F
			80 81 82 83 84 85 86 87
			88 89 8A 8B 8C 8D 8E 8F
			90 91 92 93 94 95 96 97
			98 99 9A 9B 9C 9D 9E 9F
			A0 A1 A2 A3 A4 A5 A6 A7
			A8 A9 AA AB AC AD AE AF
			B0 B1 B2 B3 B4 B5 B6 B7
			B8 B9 BA BB BC BD BE BF
			C0 C1 C2 C3 C4 C5 C6 C7
			C8 C9 CA CB CC CD CE CF
			D0 D1 D2 D3 D4 D5 D6 D7
			D8 D9 DA DB DC DD DE DF
			E0 E1 E2 E3 E4 E5 E6 E7
			E8 E9 EA EB EC ED EE EF
			F0 F1 F2 F3 F4 F5 F6 F7
			F8 F9 FA FB FC FD FE FF
						];

		qcom,mdss-dsi-on-command-state = "dsi_hs_mode";
		qcom,mdss-dsi-off-command-state = "dsi_hs_mode";
		zte,mdss-dsi-ce-command-state = "dsi_lp_mode";
		zte,mdss-dsi-cabc-command-state = "dsi_lp_mode";
		zte,mdss-dsi-ce-cabc-command-state = "dsi_lp_mode";
		qcom,mdss-dsi-h-sync-pulse = <1>;
		qcom,mdss-dsi-traffic-mode = "burst_mode";
		qcom,mdss-dsi-bllp-eof-power-mode;
		qcom,mdss-dsi-bllp-power-mode;
		qcom,mdss-dsi-lane-0-state;
		qcom,mdss-dsi-lane-1-state;
		qcom,mdss-dsi-lane-2-state;
		qcom,mdss-dsi-lane-3-state;
		//command need start
		qcom,mdss-dsi-te-pin-select = <1>;
		//qcom,mdss-dsi-wr-mem-start = <0x2c>;
		qcom,mdss-dsi-te-dcs-command = <1>;
		qcom,mdss-dsi-te-check-enable;
		qcom,mdss-dsi-te-using-te-pin;
		//command need end
		qcom,mdss-dsi-panel-timings = [EE 38 26 00 68 6E 2A 3C 2C 03 04 00];
		qcom,mdss-dsi-t-clk-post = <0x02>;
		qcom,mdss-dsi-t-clk-pre = <0x2C>;
		qcom,mdss-dsi-bl-min-level = <1>;
		qcom,mdss-dsi-bl-max-level = <4095>;
		qcom,mdss-dsi-dma-trigger = "trigger_sw";
		qcom,mdss-dsi-mdp-trigger = "none";
		qcom,mdss-dsi-bl-pmic-control-type = "bl_ctrl_wled";
		qcom,mdss-dsi-reset-sequence = <1 1>, <0 1>, <1 1>;
		qcom,mdss-pan-physical-width-dimension = <59>;
		qcom,mdss-pan-physical-height-dimension = <104>;
	};
};
