/* Copyright (c) 2014, The Linux Foundation. All rights reserved.
 *
 * This program is free software; you can redistribute it and/or modify
 * it under the terms of the GNU General Public License version 2 and
 * only version 2 as published by the Free Software Foundation.
 *
 * This program is distributed in the hope that it will be useful,
 * but WITHOUT ANY WARRANTY; without even the implied warranty of
 * MERCHANTABILITY or FITNESS FOR A PARTICULAR PURPOSE.  See the
 * GNU General Public License for more details.
 */

&soc {
	i2c@78b6000 { /* BLSP1 QUP3 */
		aw2013_led@45 {
			aw2013_led,name = "aw2013";
			compatible = "aw2013";
			vdd-supply = <&pm8950_l10>;
			qcom,vdd-io-always-on;
			qcom,vdd-io-lpm-sup;
			qcom,vdd-voltage-level = <2750000 2950000>;
			qcom,vdd-current-level = <200 800000>;
			reg = <0x45>;
		};
	};
};
